#include <STC15Wxxxx.H>
#include "comm.h"
#include "angle.h"
#include "pwm.h"
//-----------------------------------
//	        变量定义
//-----------------------------------
bit     busy;				           //忙标志-串口3
bit     Screen_flag;	                       //屏幕刷新使能标志位，100ms一次
uchar   Re_buf[11];		     	           //6050模块包数据缓存数区
uchar   Re_counter = 0; 			     //6050模块包数据计数变量
uchar   Rebuf_PID[8];				     //上位机PID参数包数据缓存区
uchar   Screen_count = 0;			     //屏幕刷新计数值
//---------------------------------------------------------
//   串口初始化：115200bps@24.000MHz 定时器2作波特率发生器
//   串口1与计算机上位机通信 [P3.0/RXD   P3.1/TXD ]
//   串口2与MPU6050模块通信  [P1.0/RXD2  P1.1/TXD2]
//   串口3与串口屏通信	     [P0.0/RXD3  P0.1/TXD3]
//---------------------------------------------------------
void Uart_Init(void)		
{	
	S2CON = 0x50;		//串口2：8位数据,可变波特率,允许接收
	S3CON = 0x10;		//串口3：8位数据,可变波特率,允许接收
	S3CON &= 0xBF;		//串口3选择定时器2为波特率发生器
			
	AUXR |= 0x04;		//定时器2时钟为Fosc,即1T
	T2L  = 0xCC;		//设定定时初值
	T2H  = 0xFF;		//设定定时初值
	AUXR |= 0x10;		//启动定时器2

	IE2 |= 0x08;	     	//开串口3中断
	EA = 1;			//开总中断
}
//-----------------------------
//       IO口初始化
//-----------------------------
void GPIO_Init(void)
{
					//所有IO口设为准双向
	P0M0 = 0x00;P0M1 = 0x00;
    	P1M0 = 0x00;P1M1 = 0x00;
    	P2M0 = 0x00;P2M1 = 0x00;
    	P3M0 = 0x00;P3M1 = 0x00;
    	P4M0 = 0x00;P4M1 = 0x00;
    	P5M0 = 0x00;P5M1 = 0x00;     
					//设置所需要的IO口为强推输出
	P2M0 = 0x0e;P2M1 = 0x00;
	P3M0 = 0x80;P3M1 = 0x00;
}
//----------------------------
//       串口3发送数据
//----------------------------
void SendData(uchar dat)
{
    while (busy);                //等待前面的数据发送完成
    busy = 1;
    S3BUF = dat;                 //写数据到UART3数据寄存器
}
void SendString(char *s)
{
    while (*s) SendData(*s++);   //检测字符串结束标志
}
//------------------------------------------
//串口2中断服务程序  
//用于解析MPU6050姿态模块传出的参数
//参数内容：加速度数据、角速度数据、角度数据
//------------------------------------------
void Uart2_service() interrupt 8  
{
	if (S2CON & S2RI)						    //S2RI位置位
	{
		S2CON &= ~S2RI;                               //清除S2RI位
		Re_buf[Re_counter] = S2BUF;			    //串口2数据缓冲区的数据放入接收数组中
		if(Re_counter==0&&Re_buf[0]!=0x55) return;    //第0号数据不是帧头，跳过
	      Re_counter++;         				    //数组指针加一
	    	if(Re_counter==11)                            //接收到第11个数据，即一包数据接收完成
	      {    
	            Re_counter=0;                           //清零，准备下一包数据接收       
			switch(Re_buf [1])			    //判断包类型
			{						    //加速度包
				case 0x53:
				Angle_X = ((short)(Re_buf[3]<<8| Re_buf[2]))/32768.0*180-0.03;	//0.03-X轴静态偏差		
				Angle_Y = ((short)(Re_buf[5]<<8| Re_buf[4]))/32768.0*180-1.61;	//1.61-Y轴静态偏差		
				break;				
				default:  break;						
			} 
	      }
	  }    
}
//----------------------------
//    串口3中断服务程序
//----------------------------
void Uart3_service()  interrupt 17  
{
    if (S3CON & S3TI)
    {
        S3CON &= ~S3TI;         //清除S3TI位
        busy = 0;               //清忙标志
    }
}